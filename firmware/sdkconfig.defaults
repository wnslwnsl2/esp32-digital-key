## firmware/sdkconfig.defaults
```kconfig
# ========== Target & Base ==========
CONFIG_IDF_TARGET="esp32s3"
CONFIG_ESP_DEFAULT_CPU_FREQ_240=y
CONFIG_ESP_DEFAULT_CPU_FREQ_MHZ=240
CONFIG_ESP_MAIN_TASK_STACK_SIZE=8192
CONFIG_ESP_TIMER_TASK_STACK_SIZE=3072
CONFIG_ESP_SYSTEM_EVENT_TASK_STACK_SIZE=2048
CONFIG_FREERTOS_HZ=1000
CONFIG_FREERTOS_IDLE_TASK_STACKSIZE=1280
CONFIG_FREERTOS_TIMER_TASK_STACK_DEPTH=3072

# ========== Flash ==========
CONFIG_ESPTOOLPY_FLASHMODE_DIO=y
CONFIG_ESPTOOLPY_FLASHFREQ_80M=y
CONFIG_ESPTOOLPY_FLASHSIZE_8MB=y
CONFIG_ESPTOOLPY_FLASHSIZE="8MB"

# ========== Partition Table ==========
CONFIG_PARTITION_TABLE_CUSTOM=y
CONFIG_PARTITION_TABLE_CUSTOM_FILENAME="partitions.csv"
CONFIG_PARTITION_TABLE_FILENAME="partitions.csv"
CONFIG_PARTITION_TABLE_OFFSET=0x10000

# ========== Console (USB Serial JTAG) ==========
CONFIG_ESP_CONSOLE_USB_SERIAL_JTAG=y
CONFIG_ESP_CONSOLE_SECONDARY_NONE=y
CONFIG_ESP_CONSOLE_USB_SERIAL_JTAG_TX_BUF_SIZE=256
CONFIG_ESP_CONSOLE_USB_SERIAL_JTAG_RX_BUF_SIZE=256
CONFIG_USB_SERIAL_JTAG_ENABLED=y
CONFIG_ESP_CONSOLE_USB_SERIAL_JTAG_SUPPORT_VFS=y

# ========== WiFi + BLE coexistence ==========
CONFIG_ESP_WIFI_SW_COEXIST_ENABLE=y

# ========== NimBLE ==========
CONFIG_BT_ENABLED=y
CONFIG_BT_NIMBLE_ENABLED=y
CONFIG_BT_NIMBLE_MAX_CONNECTIONS=3
CONFIG_BT_NIMBLE_ROLE_CENTRAL=n
CONFIG_BT_NIMBLE_ROLE_OBSERVER=n
CONFIG_BT_NIMBLE_LOG_LEVEL_WARNING=y

# ========== mbedTLS (ECC P-256) ==========
CONFIG_MBEDTLS_ECP_DP_SECP256R1_ENABLED=y
CONFIG_MBEDTLS_ECDSA_C=y
CONFIG_MBEDTLS_ECP_C=y

# ========== NVS ==========
CONFIG_NVS_ENCRYPTION=n

# ========== Logging ==========
CONFIG_LOG_DEFAULT_LEVEL_INFO=y

# ========== Secure Boot V2 ==========
CONFIG_SECURE_BOOT=y
CONFIG_SECURE_BOOT_V2_ENABLED=y
CONFIG_SECURE_SIGNED_APPS_NO_SECURE_BOOT=n
CONFIG_SECURE_BOOT_BUILD_SIGNED_BINARIES=y
CONFIG_SECURE_BOOT_CHECK_SIGNATURE_ON_BOOT=y
CONFIG_SECURE_BOOT_SIGNING_KEY="keys/secure_boot_signing_key.pem"
CONFIG_SECURE_BOOT_VERIFICATION_KEY_DIGEST_LEN=32
CONFIG_SECURE_BOOT_ALLOW_JTAG=y
CONFIG_SECURE_BOOT_ALLOW_ROM_BASIC=y
CONFIG_SECURE_BOOT_INSECURE=n
CONFIG_SECURE_BOOT_ENABLE_AGGRESSIVE_KEY_REVOKE=n

# ========== Flash Encryption ==========
CONFIG_SECURE_FLASH_ENC_ENABLED=y
CONFIG_SECURE_FLASH_ENCRYPTION_MODE_DEVELOPMENT=y
CONFIG_SECURE_FLASH_ENCRYPTION_MODE_RELEASE=n
CONFIG_SECURE_FLASH_ENCRYPTION_AES256=y
CONFIG_SECURE_FLASH_ENCRYPT_ONLY_IMAGE_LEN_IN_APP_PART=n
CONFIG_SECURE_FLASH_ENCRYPTION_KEYFILE="keys/flash_encryption_key.bin"

# UART recovery (protected by secure boot)
CONFIG_SECURE_DISABLE_ROM_DL_MODE=n
CONFIG_SECURE_ENABLE_SECURE_ROM_DL_MODE=n
CONFIG_SECURE_FLASH_UART_BOOTLOADER_ALLOW_ENC=y
CONFIG_SECURE_FLASH_UART_BOOTLOADER_ALLOW_DEC=y
CONFIG_SECURE_FLASH_UART_BOOTLOADER_ALLOW_CACHE=y

# ========== Protection ==========
CONFIG_COMPILER_STACK_CHECK_MODE_NORM=y
CONFIG_COMPILER_STACK_CHECK=y
CONFIG_HEAP_POISONING_LIGHT=y
CONFIG_HEAP_CORRUPTION_DETECTION=CONFIG_HEAP_CORRUPTION_DETECTION_LIGHT

# ========== Debug & Safety ==========
CONFIG_ESP32S3_DEBUG_OCDAWARE=y
CONFIG_ESP_SYSTEM_PANIC_PRINT_HALT=y
CONFIG_ESP_SYSTEM_PANIC_SILENT_REBOOT=n
CONFIG_ESP_TASK_WDT=y
CONFIG_ESP_TASK_WDT_PANIC=y
CONFIG_ESP_TASK_WDT_TIMEOUT_S=5

# ========== Compiler ==========
CONFIG_COMPILER_OPTIMIZATION_SIZE=y
CONFIG_COMPILER_OPTIMIZATION_DEBUG=n
CONFIG_COMPILER_OPTIMIZATION_ASSERTIONS_ENABLE=y
CONFIG_COMPILER_OPTIMIZATION_ASSERTION_LEVEL=1

# ========== Bootloader ==========
CONFIG_BOOTLOADER_APP_ROLLBACK_ENABLE=y
CONFIG_BOOTLOADER_APP_ANTI_ROLLBACK=n
CONFIG_BOOTLOADER_APP_SECURE_VERSION=0
CONFIG_BOOTLOADER_EFUSE_SECURE_VERSION_EMULATE=n
```
